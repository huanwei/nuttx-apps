## testing/ortbad/Kconfig
```kconfig
config TESTING_ORTBAD
	tristate "[ORT] ORT-A user-fault isolation test"
	default n
	---help---
		[ORT] 验证 MMU 平台（ARMv7-A）：用户进程越界只终止该进程，
		不 panic 内核。

		与 ortmem 的区别：那边验证的是 MPU 的**隔离机制**；
		这边 MMU 的隔离是天然给的，要验证的是**故障处理策略** ——
		NuttX 默认 PANIC_WITH_REGS，一个进程越界会带走整机。

if TESTING_ORTBAD

config TESTING_ORTBAD_PRIORITY
	int "ortbad task priority"
	default 100

config TESTING_ORTBAD_STACKSIZE
	int "ortbad stack size"
	default 2048

endif # TESTING_ORTBAD
```

## testing/ortd/Kconfig
```kconfig
config TESTING_ORTD
	tristate "[ORT] ORT deploy/O&M agent prototype"
	default n
	depends on TESTING_ORTSUP
	---help---
		[ORT] 部署 / O&M 代理原型。

		★ 它存在的理由是把**配置递送**从实时控制环里切出去：

		  在此之前，监督者每 2 秒自己 fopen manifest 并逐行解析 ——
		  也就是实时控制环里做文件 I/O。硬实时关心的是最坏耗时，
		  而 hostfs / flash 的最坏延迟都不可控。

		  切分后：本代理（非实时约束）负责读文件、把原样字节放进
		  内核配置槽；监督者每周期只读一个标量，变了才取回并自己校验。

		这与 Wind River 是同一个形状：VxWorks 653 是 Module OS 在 init 期
		装载配置 + mode manager 分区请求变更；VxWorks 7 是目标上另跑一个
		kubelet（不参与实时调度）；Studio OTA 是设备侧独立的 eSync agent。

		设计见 proposals/《序驰 OrdinRT (ORT) 部署与 O&M 组件设计.md》。

		依赖 TESTING_ORTSUP：本原型目前只服务于 ortsup 的配置递送。

if TESTING_ORTD

config TESTING_ORTD_PRIORITY
	int "ortd task priority"
	default 120

config TESTING_ORTD_STACKSIZE
	int "ortd stack size"
	default 4096

config TESTING_ORTD_PATH
	string "ortd default manifest path"
	default "/system/etc/ort.cfg"

endif # TESTING_ORTD
```

## testing/orthello/Kconfig
```kconfig
config TESTING_ORTHELLO
	tristate "[ORT-A] 镜像里的程序（夹具角色；被嵌进镜像层后从挂载视图 exec）"
	default n
	---help---
		[ORT-A / A1→A2] "镜像到进程"的桥：本程序被打进 OCI 层
		（fixture-gen 嵌 bin/orthello 进 layer0），运行时从 unionfs
		挂载视图 exec，读一个镜像里的文件并打印内容（手册 §三·补六十七）。

if TESTING_ORTHELLO

config TESTING_ORTHELLO_PRIORITY
	int "orthello task priority"
	default 100

config TESTING_ORTHELLO_STACKSIZE
	int "orthello stack size"
	default 4096

endif # TESTING_ORTHELLO
```

## testing/ortimg/Kconfig
```kconfig
config TESTING_ORTIMG
	tristate "[ORT-A] ort_image 原型（A1：受限 JSON / OCI manifest）"
	default n
	select LIB_ZLIB
	---help---
		[ORT-A / A1] ORT-A 镜像管理的第一块砖（手册 §三·补六十一）。

		当前内容：受限 JSON 解析器 + OCI image manifest 提取（白名单）
		+ registry pull + sha256 校验 + tar/gzip 解包 + unionfs 挂载视图。
		设计三条钉死：无动态分配（自身）/ 深度有界 / 字段白名单。

		select LIB_ZLIB：层体多为 tar+gzip，ort_tar 的解压路径需要 zlib
		（apps/system/zlib；构建时一次性拉取并解包 zlib13.zip）。

		用法：ortimg jsontest（双环境电池）/ manifest <path> / validate <path>
		目标机上 /system 是 hostfs，夹具路径照仓库树写：
		  /system/testing/ortimg/fixtures/alpine-manifest.json

if TESTING_ORTIMG

config TESTING_ORTIMG_PRIORITY
	int "ortimg task priority"
	default 100

config TESTING_ORTIMG_STACKSIZE
	int "ortimg stack size"
	default 8192

endif # TESTING_ORTIMG
```

## testing/ortmem/Kconfig
```kconfig
config TESTING_ORTMEM
	tristate "[ORT] MPU memory domain isolation test"
	default n
	---help---
		[ORT] 验证 MPU 内存域隔离是否生效。

if TESTING_ORTMEM

config TESTING_ORTMEM_PRIORITY
	int "ortmem task priority"
	default 100

config TESTING_ORTMEM_STACKSIZE
	int "ortmem stack size"
	default 2048

endif # TESTING_ORTMEM
```

## testing/ortsup/Kconfig
```kconfig
config TESTING_ORTSUP
	tristate "[ORT] ORT supervisor prototype (degradation state machine)"
	default n
	depends on TESTING_ORTMEM
	---help---
		[ORT] ORT 监督者（ort_safety）原型：实现降级状态机的核心闭环。

		它做三件事：
		  1. 以监督者身份启动容器（创建 + 绑域）
		  2. 接收内核的故障通知（独立通道，不依赖容器自己注册的处理器）
		  3. 按 onFailure / restartPolicy 决策，并保证状态迁移单调

		依赖 TESTING_ORTMEM：容器与故障注入都基于 ortmem 的域池。

if TESTING_ORTSUP

config TESTING_ORTSUP_PRIORITY
	int "ortsup task priority"
	default 100

config TESTING_ORTSUP_STACKSIZE
	int "ortsup stack size"
	default 4096

endif # TESTING_ORTSUP
```
